/* Auto-generated linker script fragment for LLEXT
 * Separates .rodata sections based on relocation status
 */

SECTIONS
{
    /* Read-only data WITH relocations - will be copied to RAM by LLEXT */
    .rodata : {
        *(.rodata._ZN12_GLOBAL__N_1L11arduino_adcE)
        *(.rodata._ZN12_GLOBAL__N_1L11arduino_pwmE)
        *(.rodata._ZN6zephyr7arduinoL11pinctrl_mapE)
        *(.rodata._ZN6zephyr7arduinoL12arduino_pinsE)
        *(.rodata._ZN6zephyr7arduinoL35__pinctrl_states__device_dts_ord_17E)
        *(.rodata._ZN6zephyr7arduinoL35__pinctrl_states__device_dts_ord_25E)
        *(.rodata._ZN6zephyr7arduinoL35__pinctrl_states__device_dts_ord_29E)
        *(.rodata._ZN6zephyr7arduinoL35__pinctrl_states__device_dts_ord_35E)
        *(.rodata._ZN6zephyr7arduinoL35__pinctrl_states__device_dts_ord_55E)
        *(.rodata._ZN6zephyr7arduinoL35__pinctrl_states__device_dts_ord_64E)
        *(.rodata._ZN6zephyr7arduinoL35__pinctrl_states__device_dts_ord_67E)
        *(.rodata._ZN6zephyr7arduinoL35__pinctrl_states__device_dts_ord_72E)
        *(.rodata._ZN6zephyr7arduinoL35__pinctrl_states__device_dts_ord_80E)
        *(.rodata._ZN6zephyr7arduinoL35__pinctrl_states__device_dts_ord_85E)
        *(.rodata._ZN6zephyr7arduinoL35__pinctrl_states__device_dts_ord_97E)
        *(.rodata._ZN6zephyr7arduinoL36__pinctrl_states__device_dts_ord_102E)
        *(.rodata._ZN6zephyr7arduinoL36__pinctrl_states__device_dts_ord_106E)
        *(.rodata._ZN6zephyr7arduinoL36__pinctrl_states__device_dts_ord_111E)
        *(.rodata._ZN6zephyr7arduinoL36__pinctrl_states__device_dts_ord_117E)
        *(.rodata._ZN6zephyr7arduinoL36__pinctrl_states__device_dts_ord_120E)
        *(.rodata._ZN6zephyr7arduinoL39__pinctrl_dev_config__device_dts_ord_17E)
        *(.rodata._ZN6zephyr7arduinoL39__pinctrl_dev_config__device_dts_ord_25E)
        *(.rodata._ZN6zephyr7arduinoL39__pinctrl_dev_config__device_dts_ord_29E)
        *(.rodata._ZN6zephyr7arduinoL39__pinctrl_dev_config__device_dts_ord_35E)
        *(.rodata._ZN6zephyr7arduinoL39__pinctrl_dev_config__device_dts_ord_55E)
        *(.rodata._ZN6zephyr7arduinoL39__pinctrl_dev_config__device_dts_ord_64E)
        *(.rodata._ZN6zephyr7arduinoL39__pinctrl_dev_config__device_dts_ord_67E)
        *(.rodata._ZN6zephyr7arduinoL39__pinctrl_dev_config__device_dts_ord_72E)
        *(.rodata._ZN6zephyr7arduinoL39__pinctrl_dev_config__device_dts_ord_80E)
        *(.rodata._ZN6zephyr7arduinoL39__pinctrl_dev_config__device_dts_ord_85E)
        *(.rodata._ZN6zephyr7arduinoL39__pinctrl_dev_config__device_dts_ord_97E)
        *(.rodata._ZN6zephyr7arduinoL40__pinctrl_dev_config__device_dts_ord_102E)
        *(.rodata._ZN6zephyr7arduinoL40__pinctrl_dev_config__device_dts_ord_106E)
        *(.rodata._ZN6zephyr7arduinoL40__pinctrl_dev_config__device_dts_ord_111E)
        *(.rodata._ZN6zephyr7arduinoL40__pinctrl_dev_config__device_dts_ord_117E)
        *(.rodata._ZN6zephyr7arduinoL40__pinctrl_dev_config__device_dts_ord_120E)
        *(.rodata._ZTV13BridgeMonitorILj512EE)
        *(.rodata._ZTV15SerialTransport)
        *(.rodata._ZTV18RpcFunctionWrapperISt8functionIFSt5tupleIJiSt6vectorIhSaIhEEEEhhS4_EEE)
        *(.rodata._ZTV18RpcFunctionWrapperISt8functionIFSt5tupleIJiSt6vectorIhSaIhEEEEhhtEEE)
        *(.rodata._ZTV18RpcFunctionWrapperISt8functionIFSt5tupleIJiSt6vectorIhSaIhEEEEhtEEE)
        *(.rodata._ZTV18RpcFunctionWrapperISt8functionIFSt5tupleIJiSt6vectorIiSaIiEEEES4_EEE)
        *(.rodata._ZTV18RpcFunctionWrapperISt8functionIFSt5tupleIJijEEhEEE)
        *(.rodata._ZTV18RpcFunctionWrapperISt8functionIFSt5tupleIJijEEhhjEEE)
        *(.rodata._ZTV18RpcFunctionWrapperISt8functionIFSt5tupleIJijEEhjEEE)
        *(.rodata._ZTV18RpcFunctionWrapperISt8functionIFSt5tupleIJijEEhjhbEEE)
        *(.rodata._ZTV18RpcFunctionWrapperISt8functionIFiN7arduino6StringEEEE)
        *(.rodata._ZTV18RpcFunctionWrapperISt8functionIFiSt6vectorIiSaIiEES1_IfSaIfEEEEE)
        *(.rodata._ZTV18RpcFunctionWrapperISt8functionIFiSt6vectorIiSaIiEES3_EEE)
        *(.rodata._ZTV18RpcFunctionWrapperISt8functionIFihEEE)
        *(.rodata._ZTV18RpcFunctionWrapperISt8functionIFihSt6vectorIhSaIhEEEEE)
        *(.rodata._ZTV18RpcFunctionWrapperISt8functionIFihhSt6vectorIhSaIhEEEEE)
        *(.rodata._ZTV18RpcFunctionWrapperISt8functionIFivEEE)
        *(.rodata._ZTVN7arduino12ZephyrSerialE)
        *(.rodata._ZTVN7arduino9ZephyrI2CE)
        *(.rodata._ZTVN7arduino9ZephyrSPIE)
    }

    /* Read-only data WITHOUT relocations - kept in flash by LLEXT */
    .llext.rodata.noreloc : {
        *(.rodata._GLOBAL__sub_I_matrix.str1.1)
        *(.rodata._Z13lvSystemSetIpN7arduino6StringE.str1.1)
        *(.rodata._ZN10RpcDecoderILj1024EE12get_responseIN7arduino7msgpack6object5nil_tEEEbjRT_R8RpcError.str1.1)
        *(.rodata._ZN10RpcDecoderILj1024EE12get_responseIbEEbjRT_R8RpcError.str1.1)
        *(.rodata._ZN11BridgeClass11update_safeEv.str1.1)
        *(.rodata._ZN11BridgeClass12provide_safeIRFihEEEbRKN7arduino6StringEOT_.isra.0.str1.1)
        *(.rodata._ZN11BridgeClass5beginEm.str1.1)
        *(.rodata._ZN12_GLOBAL__N_1L16arduino_pwm_pinsE)
        *(.rodata._ZN13BridgeMonitorILj512EE5_readEj.str1.1)
        *(.rodata._ZN13BridgeMonitorILj512EE5writeEPKhj.str1.1)
        *(.rodata._ZN13BridgeMonitorILj512EEcvbEv.str1.1)
        *(.rodata._ZN18RpcFunctionWrapperISt8functionIFiN7arduino6StringEEEEclERNS1_7msgpack8UnpackerERNS6_6PackerE.str1.1)
        *(.rodata._ZN6zephyr7arduinoL41__pinctrl_state_pins_0__device_dts_ord_17E)
        *(.rodata._ZN6zephyr7arduinoL41__pinctrl_state_pins_0__device_dts_ord_25E)
        *(.rodata._ZN6zephyr7arduinoL41__pinctrl_state_pins_0__device_dts_ord_29E)
        *(.rodata._ZN6zephyr7arduinoL41__pinctrl_state_pins_0__device_dts_ord_35E)
        *(.rodata._ZN6zephyr7arduinoL41__pinctrl_state_pins_0__device_dts_ord_55E)
        *(.rodata._ZN6zephyr7arduinoL41__pinctrl_state_pins_0__device_dts_ord_64E)
        *(.rodata._ZN6zephyr7arduinoL41__pinctrl_state_pins_0__device_dts_ord_67E)
        *(.rodata._ZN6zephyr7arduinoL41__pinctrl_state_pins_0__device_dts_ord_72E)
        *(.rodata._ZN6zephyr7arduinoL41__pinctrl_state_pins_0__device_dts_ord_80E)
        *(.rodata._ZN6zephyr7arduinoL41__pinctrl_state_pins_0__device_dts_ord_85E)
        *(.rodata._ZN6zephyr7arduinoL41__pinctrl_state_pins_0__device_dts_ord_97E)
        *(.rodata._ZN6zephyr7arduinoL41__pinctrl_state_pins_1__device_dts_ord_17E)
        *(.rodata._ZN6zephyr7arduinoL41__pinctrl_state_pins_1__device_dts_ord_35E)
        *(.rodata._ZN6zephyr7arduinoL41__pinctrl_state_pins_1__device_dts_ord_80E)
        *(.rodata._ZN6zephyr7arduinoL41__pinctrl_state_pins_1__device_dts_ord_97E)
        *(.rodata._ZN6zephyr7arduinoL41__pinctrl_state_pins_2__device_dts_ord_17E)
        *(.rodata._ZN6zephyr7arduinoL41__pinctrl_state_pins_2__device_dts_ord_97E)
        *(.rodata._ZN6zephyr7arduinoL42__pinctrl_state_pins_0__device_dts_ord_102E)
        *(.rodata._ZN6zephyr7arduinoL42__pinctrl_state_pins_0__device_dts_ord_106E)
        *(.rodata._ZN6zephyr7arduinoL42__pinctrl_state_pins_0__device_dts_ord_111E)
        *(.rodata._ZN6zephyr7arduinoL42__pinctrl_state_pins_0__device_dts_ord_117E)
        *(.rodata._ZN6zephyr7arduinoL42__pinctrl_state_pins_0__device_dts_ord_120E)
        *(.rodata._ZN6zephyr7arduinoL42__pinctrl_state_pins_1__device_dts_ord_102E)
        *(.rodata._ZN6zephyr7arduinoL42__pinctrl_state_pins_1__device_dts_ord_106E)
        *(.rodata._ZN6zephyr7arduinoL42__pinctrl_state_pins_1__device_dts_ord_111E)
        *(.rodata._ZN6zephyr7arduinoL42__pinctrl_state_pins_1__device_dts_ord_117E)
        *(.rodata._ZN6zephyr7arduinoL42__pinctrl_state_pins_1__device_dts_ord_120E)
        *(.rodata._ZN6zephyr7arduinoL42__pinctrl_state_pins_2__device_dts_ord_102E)
        *(.rodata._ZN6zephyr7arduinoL42__pinctrl_state_pins_2__device_dts_ord_106E)
        *(.rodata._ZN6zephyr7arduinoL42__pinctrl_state_pins_2__device_dts_ord_111E)
        *(.rodata._ZN6zephyr7arduinoL42__pinctrl_state_pins_2__device_dts_ord_117E)
        *(.rodata._ZN6zephyr7arduinoL42__pinctrl_state_pins_2__device_dts_ord_120E)
        *(.rodata._ZN7RpcCallIJEE6resultIbEEbRT_.part.0.str1.1)
        *(.rodata._ZN7RpcCallIJEEC2ERKN7arduino6StringEP9RPCClientP7k_mutexS8_.str1.1)
        *(.rodata._ZN7arduino7msgpack6object3extC2EaPKhj.str1.1)
        *(.rodata._ZN8RpcErrorC2Ev.str1.1)
        *(.rodata._ZNSt6vectorIhSaIhEE7reserveEj.str1.1)
        *(.rodata._ZNSt6vectorIjSaIjEE17_M_realloc_insertIJRjEEEvN9__gnu_cxx17__normal_iteratorIPjS1_EEDpOT_.str1.1)
        *(.rodata._ZZ5glyphcE1i)
        *(.rodata._ZZ5glyphcE1k)
        *(.rodata._ZZ5glyphcE1n)
        *(.rodata._ZZ5glyphcE1o)
        *(.rodata._ZZ5glyphcE1p)
        *(.rodata._ZZ5glyphcE1r)
        *(.rodata._ZZ5glyphcE1u)
        *(.rodata._ZZ5glyphcE3dot)
        *(.rodata._ZZ5glyphcE4dash)
        *(.rodata._ZZ5glyphcE5blank)
        *(.rodata._ZZ5glyphcE5colon)
        *(.rodata._ZZ5glyphcE6digits)
        *(.rodata.loop.str1.1)
        *(.rodata.setup.str1.1)
        *(.rodata.str1.1)
    }

    /* Merge all .rel.rodata.* sections into .rel.rodata */
    .rel.rodata : {
        *(.rel.rodata)
        *(.rel.rodata.*)
    }

    /* Merge all .rela.rodata.* sections into .rela.rodata */
    .rela.rodata : {
        *(.rela.rodata)
        *(.rela.rodata.*)
    }

}
